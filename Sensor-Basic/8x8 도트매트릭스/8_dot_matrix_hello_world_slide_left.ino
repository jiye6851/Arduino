//여러 줄을 묶은 매크로 '\' 이용, '\' 뒤에 어떤것도 없어야됨, 표현할 문자를 2진수로 정의 새로운 문자 추가 가능.
#define SPACE { \
    {0, 0, 0, 0, 0, 0, 0, 0}, \
    {0, 0, 0, 0, 0, 0, 0, 0}, \
    {0, 0, 0, 0, 0, 0, 0, 0}, \
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    {0, 0, 0, 0, 0, 0, 0, 0}, \
}
#define H { \
    {0, 1, 0, 0, 0, 0, 1, 0}, \
    {0, 1, 0, 0, 0, 0, 1, 0}, \
    {0, 1, 0, 0, 0, 0, 1, 0}, \
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    {0, 1, 0, 0, 0, 0, 1, 0}  \
}
#define E  { \
    {0, 1, 1, 1, 1, 1, 1, 0}, \
    {0, 1, 0, 0, 0, 0, 0, 0}, \
    {0, 1, 0, 0, 0, 0, 0, 0}, \
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    {0, 1, 1, 1, 1, 1, 1, 0}  \
}
#define L { \
    {0, 1, 0, 0, 0, 0, 0, 0}, \
    {0, 1, 0, 0, 0, 0, 0, 0}, \
    {0, 1, 0, 0, 0, 0, 0, 0}, \
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    {0, 1, 1, 1, 1, 1, 1, 0}  \
}
#define O { \
    {0, 0, 0, 1, 1, 0, 0, 0},\
    {0, 0, 1, 0, 0, 1, 0, 0},\
    {0, 1, 0, 0, 0, 0, 1, 0},\
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    {0, 0, 0, 1, 1, 0, 0, 0},\
}
#define W { \
    {1, 0, 0, 0, 0, 0, 0, 1},\
    {1, 0, 0, 0, 0, 0, 1, 0},\
    {1, 0, 0, 0, 0, 0, 1, 0},\
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    {0, 0, 0, 1, 1, 0, 0, 0},\
}
#define R { \
    {1, 1, 1, 1, 1, 0, 0, 0},\
    {1, 0, 0, 0, 1, 0, 0, 0},\
    {1, 0, 0, 0, 1, 0, 0, 0},\
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    {1, 0, 0, 0, 0, 1, 0, 0},\
}
#define D { \
    {1, 1, 1, 1, 1, 0, 0, 0},\
    {1, 1, 0, 0, 1, 1, 0, 0},\
    {1, 1, 0, 0, 0, 1, 1, 0},\
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    {1, 1, 1, 1, 1, 0, 0, 0},\
}

byte rowPin[8] = {2, 7, 19, 5, 13, 18, 12, 16};  // {1행, 2행, 3행, 4행, 5행, 6행, 7행, 8행}
byte colPin[8] = {6, 11, 10, 3, 17, 4, 8, 9};    // {1열, 2열, 3열, 4열, 5열, 6열, 7열, 8열} 

unsigned long startTime = 0;

const int numPatterns = 12;  //표현할 글자 수
byte patterns[numPatterns][8][8] = {  //표현할 문자 패턴, numPatterns 의 갯수에 맞게 표시
  SPACE,H,E,L,L,O,W,O,R,L,D,SPACE      //H,E,L,L,O,SPACE
};
                   
void setup() {
  for (byte i = 0; i < 8; i++) {
    pinMode(rowPin[i], OUTPUT);
    pinMode(colPin[i], OUTPUT);
  }
}

void loop() {
  setonoff();
}

void setonoff() { 
  for (byte i = 0; i <= (numPatterns-1) * 8 ; i++,  startTime = millis()) { // 전체 칸수, 시간 초기화
    while (millis() - startTime < 60) {  // 한칸 이동 시간
      for (byte j = 0; j < 8; j++) { // row 위치 조정
        for (byte k =0; k < 8; k++) { // col 위치 조정
          boolean a = !patterns[(i+k)/8][j][(i+k)%8]; // (i+k)/8: 열 한칸씩 이동, (i+k)%8: 이동만큼 열위치 회전
          digitalWrite(colPin[k], a); // col 핀 제어
        }
      digitalWrite(rowPin[j], HIGH); // row 핀 제어
      delay(1);
      digitalWrite(rowPin[j], LOW);
      }
    }
  }
}
